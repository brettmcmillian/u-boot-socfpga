## board/crossfield/ctlcc001_0_qspi/its/kernel-sign.its
```
/*
 * Copyright (C) 2019 Crossfield Technology LLC. All rights reserved
 *
 * SPDX-License-Identifier: GPL-2.0
 */

/dts-v1/;

/ {
	description = "Linux kernel image with FDT blob";
	#address-cells = <1>;

	images {
		kernel {
			description = "Linux Kernel";
			data = /incbin/("Image");
			type = "kernel";
			arch = "arm64";
			os = "linux";
			compression = "none";
			load = <0x2080000>;
			entry = <0x2080000>;
			hash {
				algo = "sha256";
			};
		};
		fdt {
			description = "Linux DTB";
			data = /incbin/("ctlcc001_0_qspi.dtb");
			type = "flat_dt";
			arch = "arm64";
			compression = "none";
			hash {
				algo = "sha256";
			};
		};
	};
	configurations {
		default = "conf";
		conf {
			description = "Linux boot configuration";
			kernel = "kernel";
			fdt = "fdt";
			signature {
				algo = "sha256,rsa4096";
				key-name-hint = "dev";
				sign-images = "fdt", "kernel";
			};
		};
	};
};
```
